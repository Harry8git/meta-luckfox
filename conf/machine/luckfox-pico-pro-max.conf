## conf/machine/luckfox-pico-pro-max.conf
```bitbake
require conf/machine/include/luckfox-rv1106.inc
KERNEL_DEVICETREE = "rockchip/rv1106g-luckfox-pico-pro-max.dtb"
RK_KERNEL_DTS_BASE = "rv1106g-luckfox-pico-pro-max"

IMAGE_FSTYPES = "wic ext4"
WKS_FILE = "luckfox-pico-pro-max-sd.wks.in"

do_image_wic[depends] += "u-boot-rockchip:do_deploy virtual/kernel:do_deploy"

MACHINE_ESSENTIAL_EXTRA_RRECOMMENDS += "rootfs-resize"
IMAGE_INSTALL:append = " luckfox-usb-gadget"
```
